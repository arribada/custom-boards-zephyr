## boards/xtensa/esp32s3_feather/Kconfig.board
```kconfig
# Copyright (c) 2022 Espressif Systems (Shanghai) Co., Ltd.
# SPDX-License-Identifier: Apache-2.0

# ESP32S3 Feather board configuration
config BOARD_ESP32S3_FEATHER
	bool "ESP32S3 Feather Board"
	depends on SOC_SERIES_ESP32S3

config BOARD_ESP32S3_FEATHER_APPCPU
	bool "ESP32S3 Board configuration for APPCPU (core 1)."
	depends on SOC_SERIES_ESP32S3 && SOC_ESP32S3_APPCPU

choice SOC_PART_NUMBER
	default SOC_ESP32S3_MINI_N8
endchoice
```
