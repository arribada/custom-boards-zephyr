## boards/arribada/linkit_core_nrf52840/linkit_core_nrf52840_defconfig
```kconfig
# SPDX-License-Identifier: Apache-2.0

# Enable MPU
CONFIG_ARM_MPU=y

# enable GPIO
CONFIG_GPIO=y

# enable uart driver
CONFIG_SERIAL=y

# enable I2C
CONFIG_I2C=y

# enable SPI
CONFIG_SPI=y

# Enable QSPI driver support
# CONFIG_SPI_NOR=y
#CONFIG_QSPI=y
#CONFIG_QSPI_NOR=y
#CONFIG_SPI_NOR=y
#CONFIG_SPI_NOR_SFDP_RUNTIME=y
CONFIG_FLASH=y
CONFIG_FLASH_PAGE_LAYOUT=y
CONFIG_FLASH_MAP=y
CONFIG_MPU_ALLOW_FLASH_WRITE=y
# Need this when storage is on MX25R08
CONFIG_NORDIC_QSPI_NOR=y# the default page size is 64K but 4K is allowed so...
CONFIG_NORDIC_QSPI_NOR_FLASH_LAYOUT_PAGE_SIZE=4096

#CONFIG_FILE_SYSTEM_LITTLEFS=y

# enable console
CONFIG_CONSOLE=y
CONFIG_UART_CONSOLE=y
```

## boards/arribada/rspb_smd_nrf52840/rspb_smd_nrf52840_defconfig
```kconfig
# SPDX-License-Identifier: Apache-2.0

# Enable MPU
CONFIG_ARM_MPU=y

# enable GPIO
CONFIG_GPIO=y

# enable uart driver
CONFIG_SERIAL=y

# enable console
CONFIG_CONSOLE=y
CONFIG_UART_CONSOLE=y

# Manage External flash:
CONFIG_FLASH=y
CONFIG_FLASH_PAGE_LAYOUT=y
CONFIG_FLASH_MAP=y
CONFIG_MPU_ALLOW_FLASH_WRITE=y
CONFIG_NORDIC_QSPI_NOR=y

# Enable SPI dedicated to Artic
CONFIG_SPI=y

# Enable I2C for sensors
CONFIG_I2C=y
```
